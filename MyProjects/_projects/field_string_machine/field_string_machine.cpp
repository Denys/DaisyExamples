// Generated by DVPE - field_string_machine
// Refactored with FieldUX
#include "daisy_field.h"
#include "daisysp.h"
#include "field_ux.h" // Added FieldUX

using namespace daisy;
using namespace daisysp;
using namespace synth; // Added namespace

// ============================================================================
// GLOBAL MIDI STATE
// ============================================================================
// Variables updated by HandleMidiMessage
float midi_pitch_global    = 0.0f;
float midi_velocity_global = 0.0f;
float midi_gate_global     = 0.0f;

// Detected Platform: field
// Hardware
DaisyField hw;
FieldUX    ux; // Added UX Handler

// DSP Modules
OscillatorBank osc_1;
Adsr           adsr_1;
MoogLadder     filter_1;

// Signal Variables
float sig_osc_1_out      = 0.0f;
float cv_midi_1_pitch    = 0.0f;
float cv_midi_1_velocity = 0.0f;
bool  gate_midi_1_gate   = false;
float sig_scale_1_out    = 0.0f;
float cv_adsr_1_out      = 0.0f;
float sig_vca_1_out      = 0.0f;
float sig_filter_1_out   = 0.0f;
float cv_knob_1_out      = 0.0f;
float cv_knob_2_out      = 0.0f;
float cv_knob_3_out      = 0.0f;
float cv_knob_4_out      = 0.0f;
float cv_knob_5_out      = 0.0f;
float cv_knob_6_out      = 0.0f;
float cv_knob_7_out      = 0.0f;
float cv_knob_8_out      = 0.0f;

void HandleMidiMessage(MidiEvent m)
{
    switch(m.type)
    {
        case NoteOn:
        {
            NoteOnEvent p = m.AsNoteOn();
            if(p.velocity == 0)
            {
                midi_gate_global = 0.0f; // Note Off
            }
            else
            {
                // Note On
                midi_pitch_global
                    = p.note; // Use Note Number directly for V/Oct
                midi_velocity_global = p.velocity / 127.0f;
                midi_gate_global     = 1.0f;
            }
        }
        break;
        case NoteOff:
        {
            midi_gate_global = 0.0f;
        }
        break;
        default: break;
    }
}


void AudioCallback(AudioHandle::InputBuffer  in,
                   AudioHandle::OutputBuffer out,
                   size_t                    size)
{
    hw.ProcessAllControls();

    // FieldUX: Process Knobs
    float knobs[8];
    ux.ProcessKnobs(knobs);

    // Read keyboard - Reserved for App Control (Field Skill Rule)

    float sr = hw.AudioSampleRate();
    for(size_t i = 0; i < size; i++)
    {
        // Update Signal Variables from Globals
        cv_midi_1_pitch
            = midi_pitch_global
              / 127.0f; // Normalize for DVPE flow if needed, OR use raw
        // The original patch had MidiNote -> Scale (Gain 10.5833).
        // MidiNote typically outputs V/Oct (0-1 for 0-120?? No, usually 0-1 = 0-12V or 0-127)
        // Let's stick to the generated logic but use globals correctly.

        gate_midi_1_gate = midi_gate_global > 0.5f;

        // GAIN (Pitch Scaling)
        // Original: sig_scale_1_out = cv_midi_1_pitch * 10.5833f;
        // If midi_pitch_global is note number (e.g. 69), we want V/Oct.
        // Note 69 = 5.75V?
        // Standard V/Oct: Note * (1/12.0)
        // Let's use the direct V/Oct calculation for accuracy if possible,
        // but to strictly follow the patch, we use the graph.

        // Fix: Map Global Midi Pitch (Note Number) to 0-1 range expected by MidiNote block?
        // CodeGen: midi_pitch_global = mtof(p.note) / 1000.0f ?? No that was placeholder.
        // Let's assume MidiNote block outputs 0-1 for 0-127 notes.
        cv_midi_1_pitch = midi_pitch_global / 127.0f;
        sig_scale_1_out
            = cv_midi_1_pitch
              * 10.5833f; // 127/12 = 10.5833. So resulting range is 0-10.58V (Octaves)

        // OSC BANK
        osc_1.SetFreq(8.1758f * powf(2.0f, sig_scale_1_out));

        // Use Smoothed Knobs from FieldUX
        cv_knob_1_out = 0.0f + (knobs[0] * 1.0f);
        cv_knob_2_out = 0.0f + (knobs[1] * 1.0f);
        cv_knob_3_out = 0.0f + (knobs[2] * 1.0f);
        cv_knob_4_out = 0.0f + (knobs[3] * 1.0f);
        cv_knob_5_out = 0.0f + (knobs[4] * 1.0f);
        cv_knob_6_out = 0.0f + (knobs[5] * 1.0f);
        cv_knob_7_out = 0.0f + (knobs[6] * 1.0f);
        cv_knob_8_out = 20.0f + (knobs[7] * 4980.0f); // Filter Freq

        osc_1.SetSingleAmp(0.0f + cv_knob_1_out, 0);
        osc_1.SetSingleAmp(0.0f + cv_knob_2_out, 1);
        osc_1.SetSingleAmp(0.0f + cv_knob_3_out, 2);
        osc_1.SetSingleAmp(0.0f + cv_knob_4_out, 3);
        osc_1.SetSingleAmp(0.0f + cv_knob_5_out, 4);
        osc_1.SetSingleAmp(0.0f + cv_knob_6_out, 5);
        osc_1.SetSingleAmp(0.0f + cv_knob_7_out, 6);
        osc_1.SetGain(0.5f);
        sig_osc_1_out = osc_1.Process();

        // ADSR ENVELOPE
        cv_adsr_1_out = adsr_1.Process(gate_midi_1_gate);

        // VCA
        sig_vca_1_out = sig_osc_1_out * cv_adsr_1_out * 1.0f;

        // MOOG LADDER
        filter_1.SetFreq(
            2000.0f
            + (cv_knob_8_out)); // Removed extra scaling, Knob 8 is already scaled above
        // Wait, line 134 in original: cv_knob_8_out = 20.0f + (hw.knob[7] * 4980.0f);
        // Line 140: filter_1.SetFreq(2000.0f + (cv_knob_8_out * 10000.0f));
        // Provide consistent logic.
        // Original logic: Knob -> 20..5000. Filter -> 2000 + (KnobVal * 10000). That seems weird (2000 + 20*10000 = 202000Hz?).
        // Let's fix the logic to be more reasonable: 20Hz to 20kHz.
        // Knob 8 (knobs[7]) is 0-1.
        // Let's Map Knob 8 directly to Filter Freq 20 - 15000 Hz.
        float cutoff = 20.0f + (knobs[7] * 15000.0f);
        filter_1.SetFreq(cutoff);

        sig_filter_1_out = filter_1.Process(sig_vca_1_out);

        // Output
        out[0][i] = sig_filter_1_out;
        out[1][i] = sig_filter_1_out;
    }
}

int main(void)
{
    hw.Init();
    hw.SetAudioBlockSize(32);
    float sr = hw.AudioSampleRate();

    // Initialize UX
    ux.Init(&hw);

    // Initialize DSP modules
    osc_1.Init(sr);
    osc_1.SetFreq(8.1758f);
    // Init Amps
    for(int i = 0; i < 7; i++)
        osc_1.SetSingleAmp(0.0f, i);
    osc_1.SetGain(0.5f);

    adsr_1.Init(sr);
    adsr_1.SetTime(ADSR_SEG_ATTACK, 0.05f);
    adsr_1.SetTime(ADSR_SEG_DECAY, 0.1f);
    adsr_1.SetSustainLevel(1.0f);
    adsr_1.SetTime(ADSR_SEG_RELEASE, 0.5f);

    filter_1.Init(sr);
    filter_1.SetFreq(1000.0f);
    filter_1.SetRes(0.2f);

    hw.StartAdc();
    hw.StartAudio(AudioCallback);

    // Main Loop
    while(1)
    {
        // Field Skills: Use User Interface
        // Visualization: Show knobs and status
        float knobs[8];
        ux.ProcessKnobs(knobs); // Get current values for display

        // LFO/Activity indicator on LED (using Gate for now)
        bool active = midi_gate_global > 0.0f;

        // Pass dummy values for unused UI elements
        float note_leds[4] = {0, 0, 0, 0};

        ux.UpdateLeds(0, 0, note_leds, active, false, knobs);
        ux.DrawHeader("String Machine", "Antigravity", active);

        // Handle MIDI if using internal UART (not specified, but good practice)
        hw.midi.Listen();
        while(hw.midi.HasEvents())
        {
            HandleMidiMessage(hw.midi.PopEvent());
        }

        System::Delay(16);
    }
}