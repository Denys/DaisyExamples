// Generated by DVPE - FieldOpus DrumMachinePro
// 2026-02-24T15:50:05.128Z

#include "daisy_seed.h"
#include "daisysp.h"

using namespace daisy;
using namespace daisysp;

// Detected Platform: seed
// Hardware
DaisySeed hw;

// DSP Modules
Metro block_metro;
StepSequencer block_step_seq;
AnalogBassDrum block_kick;
AnalogSnareDrum block_snare;
HiHat block_chat;
HiHat block_ohat;
AnalogBassDrum block_tom;

// Signal Variables
float cv_block_knob_1_out = 0.0f;
float cv_block_knob_2_out = 0.0f;
float cv_block_knob_3_out = 0.0f;
float cv_block_knob_4_out = 0.0f;
float cv_block_knob_5_out = 0.0f;
float cv_block_knob_6_out = 0.0f;
float cv_block_knob_7_out = 0.0f;
float cv_block_knob_8_out = 0.0f;
bool gate_block_metro_out = false;
bool gate_block_step_seq_out1 = false;
bool gate_block_step_seq_out2 = false;
bool gate_block_step_seq_out3 = false;
bool gate_block_step_seq_out4 = false;
float sig_block_kick_out = 0.0f;
float sig_block_snare_out = 0.0f;
float sig_block_chat_out = 0.0f;
float sig_block_ohat_out = 0.0f;
float sig_block_tom_out = 0.0f;
float sig_block_mixer_out = 0.0f;
float sig_block_master_vol_out = 0.0f;

void AudioCallback(AudioHandle::InputBuffer in,
                   AudioHandle::OutputBuffer out,
                   size_t size) {

    // Read hardware controls
    float knob_1_val = 0.0f;
    float knob_2_val = 0.0f;
    float knob_3_val = 0.0f;
    float knob_4_val = 0.0f;

    float sr = hw.AudioSampleRate();
    for (size_t i = 0; i < size; i++) {

        // KNOB
        cv_block_knob_1_out = 0.1f + (knob_1_val * 0.9f);

        // KNOB
        cv_block_knob_2_out = 0.1f + (knob_2_val * 0.9f);

        // KNOB
        cv_block_knob_3_out = 0.05f + (knob_3_val * 0.5f);

        // KNOB
        cv_block_knob_4_out = 80.0f + (knob_4_val * 220.0f);

        // KNOB
        cv_block_knob_5_out = 0.1f + (knob_5_val * 0.9f);

        // KNOB
        cv_block_knob_6_out = 0.0f + (knob_6_val * 1.0f);

        // KNOB
        cv_block_knob_7_out = 40.0f + (knob_7_val * 200.0f);

        // KNOB
        cv_block_knob_8_out = 0.0f + (knob_8_val * 0.5f);

        // ANALOG KICK
        sig_block_kick_out = block_kick.Process(sig_block_step_seq_trig_1);

        // ANALOG SNARE
        sig_block_snare_out = block_snare.Process(sig_block_step_seq_trig_2);

        // HI-HAT
        sig_block_chat_out = block_chat.Process(sig_block_step_seq_trig_3);

        // HI-HAT
        sig_block_ohat_out = block_ohat.Process(sig_block_step_seq_trig_4);

        // ANALOG KICK
        sig_block_tom_out = block_tom.Process(sig_block_step_seq_trig_5);

        // LED
        // LED Output Pin NaN
        // Placeholder for Field LED control
        // LED Output Pin NaN
        // Placeholder for Field LED control
        // hw.led[NaN].Set(0.0f);

        // LED
        // LED Output Pin NaN
        // Placeholder for Field LED control
        // LED Output Pin NaN
        // Placeholder for Field LED control
        // hw.led[NaN].Set(0.0f);

        // MIXER
        sig_block_mixer_out = 0.0f;

        // VCA
        sig_block_master_vol_out = sig_block_mixer_out * 1.0f * 0.8f;

        // Output
        out[0][i] = 0.0f;
        out[1][i] = 0.0f;
    }
}

int main(void) {
    hw.Init();
    hw.SetAudioBlockSize(48);
    float sr = hw.AudioSampleRate();

    // Initialize DSP modules
    block_metro.Init(sr);
    block_metro.SetFreq(2.0f);
    block_step_seq.Init(sr);
    block_step_seq.SetTrackSelect(0.0f);
    block_step_seq.SetTempo(120.0f);
    block_step_seq.SetSwing(0.0f);
    block_kick.Init(sr);
    block_kick.SetFreq(52.0f);
    block_kick.SetTone(0.5f);
    block_kick.SetDecay(0.55f);
    block_kick.SetAttackFmAmount(0.5f);
    block_kick.SetSelfFmAmount(0.1f);
    block_kick.SetAccent(0.8f);
    block_snare.Init(sr);
    block_snare.SetFreq(185.0f);
    block_snare.SetTone(0.55f);
    block_snare.SetDecay(0.45f);
    block_snare.SetSnappy(0.6f);
    block_snare.SetAccent(0.75f);
    block_chat.Init(sr);
    block_chat.SetFreq(4000.0f);
    block_chat.SetTone(0.6f);
    block_chat.SetDecay(0.2f);
    block_chat.SetAccent(0.7f);
    block_chat.SetNoisiness(0.5f);
    block_ohat.Init(sr);
    block_ohat.SetFreq(4000.0f);
    block_ohat.SetTone(0.6f);
    block_ohat.SetDecay(0.5f);
    block_ohat.SetAccent(0.7f);
    block_ohat.SetNoisiness(0.5f);
    block_tom.Init(sr);
    block_tom.SetFreq(200.0f);
    block_tom.SetTone(0.65f);
    block_tom.SetDecay(0.4f);
    block_tom.SetAttackFmAmount(0.5f);
    block_tom.SetSelfFmAmount(0.1f);
    block_tom.SetAccent(0.8f);

    hw.adc.Start();
    hw.StartAudio(AudioCallback);

    while(1) {}
}