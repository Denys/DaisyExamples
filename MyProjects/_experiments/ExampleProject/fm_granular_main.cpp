// FM-Granular Synthesizer - Generated by DVPE
// Dual-voice FM + Granular synthesis for Daisy Field
// Date: 2025-12-13

#include "daisy_field.h"
#include "daisysp.h"

using namespace daisy;
using namespace daisysp;

// Hardware
DaisyField hw;

// DSP Modules - Voice 1
Fm2 fm1;
GrainletOscillator grainlet1;
MoogLadder filter1;
Adsr env1;

// DSP Modules - Voice 2
Fm2 fm2;
GrainletOscillator grainlet2;
MoogLadder filter2;
Adsr env2;

// DSP Modules - Effects Chain
Overdrive overdrive;
ReverbSc DSY_SDRAM_BSS reverb;

// Voice state
bool key1_state = false;
bool key2_state = false;
bool key1_prev = false;
bool key2_prev = false;

// Note frequencies (chromatic scale starting from C3)
const float note_freqs[16] = {
    130.81f,  // C3
    138.59f,  // C#3
    146.83f,  // D3
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    293.66f,  // D4
    311.13f   // D#4
};

void AudioCallback(AudioHandle::InputBuffer in,
                   AudioHandle::OutputBuffer out,
                   size_t size) {
    // Process all hardware controls once per audio block
    hw.ProcessAllControls();
    
    // Read knob values
    float fm_ratio = hw.knob[0].Value() * 7.5f + 0.5f;        // 0.5 - 8.0
    float fm_index = hw.knob[1].Value() * 10.0f;              // 0 - 10
    float formant = 200.0f + hw.knob[2].Value() * 4800.0f;    // 200 - 5000 Hz
    float grain_shape = hw.knob[3].Value();                    // 0.0 - 1.0
    float cutoff = 100.0f + hw.knob[4].Value() * 9900.0f;     // 100 - 10000 Hz (log scale would be better)
    float resonance = hw.knob[5].Value() * 0.95f;             // 0.0 - 0.95
    float drive = hw.knob[6].Value();                          // 0.0 - 1.0
    float reverb_feedback = hw.knob[7].Value() * 0.8f;        // 0.0 - 0.8
    
    // Read key states
    key1_state = hw.KeyboardState(0);
    key2_state = hw.KeyboardState(1);
    
    // Detect key presses (rising edge)
    bool key1_trig = key1_state && !key1_prev;
    bool key2_trig = key2_state && !key2_prev;
    key1_prev = key1_state;
    key2_prev = key2_state;
    
    // Set FM parameters
    fm1.SetRatio(fm_ratio);
    fm1.SetIndex(fm_index);
    fm2.SetRatio(fm_ratio);
    fm2.SetIndex(fm_index);
    
    // Set granular parameters
    grainlet1.SetFormantFreq(formant);
    grainlet1.SetShape(grain_shape);
    grainlet2.SetFormantFreq(formant);
    grainlet2.SetShape(grain_shape);
    
    // Set filter parameters
    filter1.SetFreq(cutoff);
    filter1.SetRes(resonance);
    filter2.SetFreq(cutoff);
    filter2.SetRes(resonance);
    
    // Set overdrive
    overdrive.SetDrive(drive);
    
    // Set reverb
    reverb.SetFeedback(reverb_feedback);
    
    // Process audio sample by sample
    for (size_t i = 0; i < size; i++) {
        // Process envelopes (use gates, not triggers for ADSR)
        float env1_out = env1.Process(key1_state);
        float env2_out = env2.Process(key2_state);
        
        // Voice 1 signal chain
        float fm1_out = fm1.Process();
        grainlet1.SetFreq(note_freqs[0]); // Use actual note from key
        float grain1_out = grainlet1.Process();
        float mixed1 = fm1_out * 0.5f + grain1_out * 0.5f;  // Mix FM and granular
        float filt1_out = filter1.Process(mixed1);
        float vca1_out = filt1_out * env1_out;
        
        // Voice 2 signal chain
        float fm2_out = fm2.Process();
        grainlet2.SetFreq(note_freqs[2]); // Different note for voice 2
        float grain2_out = grainlet2.Process();
        float mixed2 = fm2_out * 0.5f + grain2_out * 0.5f;
        float filt2_out = filter2.Process(mixed2);
        float vca2_out = filt2_out * env2_out;
        
        // Mix voices
        float mixed = (vca1_out + vca2_out) * 0.5f;
        
        // Apply overdrive
        float driven = overdrive.Process(mixed);
        
        // Apply reverb (stereo)
        float reverb_l, reverb_r;
        reverb.Process(driven, driven, &reverb_l, &reverb_r);
        
        // Output to stereo
        out[0][i] = reverb_l;
        out[1][i] = reverb_r;
    }
}

int main(void) {
    // Initialize hardware
    hw.Init();
    hw.SetAudioBlockSize(48);
    float sample_rate = hw.AudioSampleRate();
    
    // Initialize DSP modules - Voice 1
    fm1.Init(sample_rate);
    fm1.SetFrequency(note_freqs[0]);  // C3
    
    grainlet1.Init(sample_rate);
    grainlet1.SetFreq(note_freqs[0]);
    grainlet1.SetBleed(0.3f);  // Fixed bleed for smooth grains
    
    filter1.Init(sample_rate);
    
    env1.Init(sample_rate);
    env1.SetTime(ADSR_SEG_ATTACK, 0.005f);   // 5ms
    env1.SetTime(ADSR_SEG_DECAY, 0.2f);      // 200ms
    env1.SetSustainLevel(0.7f);
    env1.SetTime(ADSR_SEG_RELEASE, 0.5f);    // 500ms
    
    // Initialize DSP modules - Voice 2
    fm2.Init(sample_rate);
    fm2.SetFrequency(note_freqs[2]);  // D3 (slightly detuned)
    
    grainlet2.Init(sample_rate);
    grainlet2.SetFreq(note_freqs[2]);
    grainlet2.SetBleed(0.3f);
    
    filter2.Init(sample_rate);
    
    env2.Init(sample_rate);
    env2.SetTime(ADSR_SEG_ATTACK, 0.005f);
    env2.SetTime(ADSR_SEG_DECAY, 0.2f);
    env2.SetSustainLevel(0.7f);
    env2.SetTime(ADSR_SEG_RELEASE, 0.5f);
    
    // Initialize effects
    overdrive.Init();
    
    reverb.Init(sample_rate);
    reverb.SetFeedback(0.6f);
    reverb.SetLpFreq(8000.0f);
    
    // Start audio and ADC
    hw.StartAdc();
    hw.StartAudio(AudioCallback);
    
    // Main loop
    while(1) {
        // Update LEDs to show key states
        for(int i = 0; i < 8; i++) {
            float brightness = 0.0f;
            if(i == 0 && key1_state) brightness = 1.0f;
            if(i == 1 && key2_state) brightness = 1.0f;
            hw.led_driver.SetLed(i, brightness);
        }
        hw.led_driver.SwapBuffersAndTransmit();
        
        System::Delay(10);
    }
}



/*
// FM-Granular Synthesizer - Generated by DVPE
// Piano-Layout Chromatic Keyboard for Daisy Field
// Date: 2025-12-13

#include "daisy_field.h"
#include "daisysp.h"

using namespace daisy;
using namespace daisysp;

// Hardware
DaisyField hw;

// DSP Modules - Voice 1
Fm2 fm1;
GrainletOscillator grainlet1;
MoogLadder filter1;
Adsr env1;

// DSP Modules - Voice 2
Fm2 fm2;
GrainletOscillator grainlet2;
MoogLadder filter2;
Adsr env2;

// DSP Modules - Effects Chain
Overdrive overdrive;
ReverbSc DSY_SDRAM_BSS reverb;

// Keyboard state (16 keys total)
bool key_state[16] = {false};
bool key_prev[16] = {false};
int active_notes[2] = {-1, -1};  // Track up to 2 simultaneous notes (last-note priority)

// Piano-style keyboard layout: C3-C4
// Top Row (A):    [C3][D3][E3][F3][G3][A3][B3][C4]  (white keys)
// Bottom Row (B): [C#3][D#3][---][F#3][G#3][A#3][---][---]  (black keys)

const float KEY_FREQUENCIES[16] = {
    // Top row (A1-A8): White keys
    130.81f,  // A1 = C3
    146.83f,  // A2 = D3
    164.81f,  // A3 = E3
    174.61f,  // A4 = F3
    196.00f,  // A5 = G3
    220.00f,  // A6 = A3
    246.94f,  // A7 = B3
    261.63f,  // A8 = C4
    
    // Bottom row (B1-B8): Black keys
    138.59f,  // B1 = C#3
    155.56f,  // B2 = D#3
    0.0f,     // B3 = unused
    185.00f,  // B4 = F#3
    207.65f,  // B5 = G#3
    233.08f,  // B6 = A#3
    0.0f,     // B7 = unused
    0.0f      // B8 = unused
};

// All keys light up at full brightness when pressed
const float LED_BRIGHTNESS = 1.0f;

// Control modes
enum ControlMode {
    MODE_OSCILLATOR = 0,
    MODE_FILTER = 1,
    MODE_EFFECTS = 2
};

ControlMode current_mode = MODE_OSCILLATOR;
bool sw1_prev = false;
bool sw2_prev = false;

void UpdateActiveNotes() {
    // Collect all currently pressed keys (skip unused keys)
    int pressed_keys[16];
    int num_pressed = 0;
    
    for(int i = 0; i < 16; i++) {
        if(key_state[i] && KEY_FREQUENCIES[i] > 0.0f) {  // Only count active keys
            pressed_keys[num_pressed++] = i;
        }
    }
    
    // Last-note priority: use the most recently pressed notes
    if(num_pressed == 0) {
        active_notes[0] = -1;
        active_notes[1] = -1;
    } else if(num_pressed == 1) {
        active_notes[0] = pressed_keys[0];
        active_notes[1] = -1;
    } else {
        // Use the last two pressed notes
        active_notes[0] = pressed_keys[num_pressed - 2];
        active_notes[1] = pressed_keys[num_pressed - 1];
    }
}

void AudioCallback(AudioHandle::InputBuffer in,
                   AudioHandle::OutputBuffer out,
                   size_t size) {
    // Process all hardware controls once per audio block
    hw.ProcessAllControls();
    
    // Read mode switches (SW1/SW2 toggle between modes)
    bool sw1_state = hw.sw[0].Pressed();
    bool sw2_state = hw.sw[1].Pressed();
    
    // SW1: cycle to MODE_OSCILLATOR
    if(sw1_state && !sw1_prev) {
        current_mode = MODE_OSCILLATOR;
    }
    
    // SW2: cycle through FILTER -> EFFECTS -> OSCILLATOR
    if(sw2_state && !sw2_prev) {
        if(current_mode == MODE_OSCILLATOR) {
            current_mode = MODE_FILTER;
        } else if(current_mode == MODE_FILTER) {
            current_mode = MODE_EFFECTS;
        } else {
            current_mode = MODE_OSCILLATOR;
        }
    }
    
    sw1_prev = sw1_state;
    sw2_prev = sw2_state;
    
    // Read knob values based on current mode
    float fm_ratio, fm_index, formant, grain_shape;
    float cutoff, resonance;
    float drive, reverb_feedback;
    
    if(current_mode == MODE_OSCILLATOR) {
        // Oscillator controls
        fm_ratio = hw.knob[0].Value() * 7.5f + 0.5f;        // 0.5 - 8.0
        fm_index = hw.knob[1].Value() * 10.0f;              // 0 - 10
        formant = 200.0f + hw.knob[2].Value() * 4800.0f;    // 200 - 5000 Hz
        grain_shape = hw.knob[3].Value();                    // 0.0 - 1.0
        // Default cutoff and resonance
        cutoff = 5000.0f;
        resonance = 0.3f;
        drive = 0.0f;
        reverb_feedback = 0.3f;
    } else if(current_mode == MODE_FILTER) {
        // Filter controls
        cutoff = 100.0f + hw.knob[0].Value() * 9900.0f;     // 100 - 10000 Hz
        resonance = hw.knob[1].Value() * 0.95f;             // 0.0 - 0.95
        // Keep oscillator settings at default
        fm_ratio = 1.0f;
        fm_index = 2.0f;
        formant = 1000.0f;
        grain_shape = 0.5f;
        drive = 0.0f;
        reverb_feedback = 0.3f;
    } else { // MODE_EFFECTS
        // Effects controls
        drive = hw.knob[0].Value();                          // 0.0 - 1.0
        reverb_feedback = hw.knob[1].Value() * 0.8f;        // 0.0 - 0.8
        // Keep other settings at default
        fm_ratio = 1.0f;
        fm_index = 2.0f;
        formant = 1000.0f;
        grain_shape = 0.5f;
        cutoff = 5000.0f;
        resonance = 0.3f;
    }
    
    // Read all 16 key states
    for(int i = 0; i < 16; i++) {
        key_state[i] = hw.KeyboardState(i);
        key_prev[i] = key_state[i];
    }
    
    // Update which notes are active
    UpdateActiveNotes();
    
    // Determine frequencies for voice 1 and voice 2
    float freq1 = (active_notes[0] >= 0) ? KEY_FREQUENCIES[active_notes[0]] : 130.81f;
    float freq2 = (active_notes[1] >= 0) ? KEY_FREQUENCIES[active_notes[1]] : 146.83f;
    
    bool voice1_gate = (active_notes[0] >= 0);
    bool voice2_gate = (active_notes[1] >= 0);
    
    // Set FM parameters
    fm1.SetFrequency(freq1);
    fm1.SetRatio(fm_ratio);
    fm1.SetIndex(fm_index);
    fm2.SetFrequency(freq2);
    fm2.SetRatio(fm_ratio);
    fm2.SetIndex(fm_index);
    
    // Set granular parameters
    grainlet1.SetFreq(freq1);
    grainlet1.SetFormantFreq(formant);
    grainlet1.SetShape(grain_shape);
    grainlet2.SetFreq(freq2);
    grainlet2.SetFormantFreq(formant);
    grainlet2.SetShape(grain_shape);
    
    // Set filter parameters
    filter1.SetFreq(cutoff);
    filter1.SetRes(resonance);
    filter2.SetFreq(cutoff);
    filter2.SetRes(resonance);
    
    // Set overdrive
    overdrive.SetDrive(drive);
    
    // Set reverb
    reverb.SetFeedback(reverb_feedback);
    
    // Process audio sample by sample
    for (size_t i = 0; i < size; i++) {
        // Process envelopes
        float env1_out = env1.Process(voice1_gate);
        float env2_out = env2.Process(voice2_gate);
        
        // Voice 1 signal chain
        float fm1_out = fm1.Process();
        float grain1_out = grainlet1.Process();
        float mixed1 = fm1_out * 0.5f + grain1_out * 0.5f;
        float filt1_out = filter1.Process(mixed1);
        float vca1_out = filt1_out * env1_out;
        
        // Voice 2 signal chain
        float fm2_out = fm2.Process();
        float grain2_out = grainlet2.Process();
        float mixed2 = fm2_out * 0.5f + grain2_out * 0.5f;
        float filt2_out = filter2.Process(mixed2);
        float vca2_out = filt2_out * env2_out;
        
        // Mix voices
        float mixed = (vca1_out + vca2_out) * 0.5f;
        
        // Apply overdrive
        float driven = overdrive.Process(mixed);
        
        // Apply reverb (stereo)
        float reverb_l, reverb_r;
        reverb.Process(driven, driven, &reverb_l, &reverb_r);
        
        // Output to stereo
        out[0][i] = reverb_l;
        out[1][i] = reverb_r;
    }
}

int main(void) {
    // Initialize hardware
    hw.Init();
    hw.SetAudioBlockSize(48);
    float sample_rate = hw.AudioSampleRate();
    
    // Initialize DSP modules - Voice 1
    fm1.Init(sample_rate);
    fm1.SetFrequency(KEY_FREQUENCIES[0]);  // C3
    
    grainlet1.Init(sample_rate);
    grainlet1.SetFreq(KEY_FREQUENCIES[0]);
    grainlet1.SetBleed(0.3f);
    
    filter1.Init(sample_rate);
    
    env1.Init(sample_rate);
    env1.SetTime(ADSR_SEG_ATTACK, 0.005f);
    env1.SetTime(ADSR_SEG_DECAY, 0.2f);
    env1.SetSustainLevel(0.7f);
    env1.SetTime(ADSR_SEG_RELEASE, 0.5f);
    
    // Initialize DSP modules - Voice 2
    fm2.Init(sample_rate);
    fm2.SetFrequency(KEY_FREQUENCIES[1]);  // D3
    
    grainlet2.Init(sample_rate);
    grainlet2.SetFreq(KEY_FREQUENCIES[1]);
    grainlet2.SetBleed(0.3f);
    
    filter2.Init(sample_rate);
    
    env2.Init(sample_rate);
    env2.SetTime(ADSR_SEG_ATTACK, 0.005f);
    env2.SetTime(ADSR_SEG_DECAY, 0.2f);
    env2.SetSustainLevel(0.7f);
    env2.SetTime(ADSR_SEG_RELEASE, 0.5f);
    
    // Initialize effects
    overdrive.Init();
    
    reverb.Init(sample_rate);
    reverb.SetFeedback(0.6f);
    reverb.SetLpFreq(8000.0f);
    
    // Start audio and ADC
    hw.StartAdc();
    hw.StartAudio(AudioCallback);
    
    // Main loop
    while(1) {
        // Update LEDs - full brightness for all active keys
        for(int i = 0; i < 16; i++) {
            // Only light LEDs for valid keys (frequency > 0)
            float brightness = 0.0f;
            if(KEY_FREQUENCIES[i] > 0.0f && hw.KeyboardState(i)) {
                brightness = LED_BRIGHTNESS;
            }
            hw.led_driver.SetLed(i, brightness);
        }
        hw.led_driver.SwapBuffersAndTransmit();
        
        System::Delay(10);
    }
}

*/